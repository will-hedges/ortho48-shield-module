## boards/shields/ortho48/Kconfig.defconfig
```kconfig
# Copyright (c) 2024 will-hedges <https://github.com/will-hedges>
# SPDX-License-Identifier: MIT

if SHIELD_ORTHO48


config ZMK_KEYBOARD_NAME
	default "ortho48"


config ZMK_BACKLIGHT
	default y
if ZMK_BACKLIGHT
config PWM
	default y
config LED_PWM
	default y
config LED_GPIO
	default n if LED_PWM
endif # ZMK_BACKLIGHT


config ZMK_RGB_UNDERGLOW
    default y
if ZMK_RGB_UNDERGLOW
config WS2812_STRIP
    default y
endif # ZMK_RGB_UNDERGLOW


endif # SHIELD_ORTHO48
```

## boards/shields/ortho48/Kconfig.shield
```kconfig
# Copyright (c) 2024 will-hedges <https://github.com/will-hedges>
# SPDX-License-Identifier: MIT

config SHIELD_ORTHO48
	def_bool $(shields_list_contains,ortho48)
```
